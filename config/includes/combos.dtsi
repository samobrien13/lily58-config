/ {
    combos {
        compatible = "zmk,combos";

        combo_caps_word {
            timeout-ms = <50>;
            key-positions = <CAPS_COMBO_KEYS>;
            bindings = <&caps_word>;
            layers = <0>;
        };
    };
};
